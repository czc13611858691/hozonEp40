/*@!Encoding:936*/
includes
{
  
}

variables
{
  linFrame 0x3C diag_3c;
}

testcase NewTestCase()
{

}

void MainTest ()
{
  
}

on key 'A'
{
  diag_3c.byte(0) = 0x50;
  diag_3c.byte(1) = 2;
  diag_3c.byte(2) = 0x10;
  diag_3c.byte(3) = 0;
  diag_3c.byte(4) = 255;
  diag_3c.byte(5) = 255;
  diag_3c.byte(6) = 255;
  diag_3c.byte(7) = 255;
  diag_3c.rtr = 1;
  output(diag_3c);
}

