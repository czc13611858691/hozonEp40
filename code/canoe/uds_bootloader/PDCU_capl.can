/*@!Encoding:936*/
includes
{
  
}

variables
{
  long dwFile=5;
  char s19Filename[500];
  byte dataBuffer[0x0FFFFF];
  long data_len = 0;
  long transferData_idx=0;
  
  int iRespTimeout=500;
  enum  {
    
    //DiagnosticSessionControl $10 [DefaultSession(01h)]
    Default_Session=0,
    
    //DiagnosticSessionControl $10 [extendedDiagnosticSession(03h)]
    Extend_Session_1,
    
    //RoutineControl $31 01[CheckProgrammingPre-Conditions(0203h)]
    RoutineCTRL_CheckProgramPre,
    
    //Control DTC Seting$85[DTCSetting = off(02h)]
    CTRL_DTC_SettingOff,
    
    //CommunicationControl $28[ControlType ( #03h)CommunicationType(03h) ]
    CommunicationCTRL_Disable,
    
    //DiagnosticSessionControl $10[ProgrammingMode(02h)]
    Program_Session,
    
    //SecurityAccess. Req$27 Step#1: Request Seed(11h)
    Security_Access_Seed,
    
    //SecurityAccess. Req$27 Step#2: SecurityAccess(12h) ]
    Security_Access_Key,
    
    //RequestDownload $34
    Request_Download,
    
    //TransferData $36
    Transfer_Data,
    
    //RequestTransferExit $37
    Transfer_Exit,
    
    //Routine Control $31 01[CheckProgrammingDependencies(FF01h) ]
    RoutineCTRL_CheckProgramDependencies,
    
    //ECUReset $11[HardReset (01h)]
    Reset,
    
    //DiagnosticSessionControl $10[extendedDiagnosticSession(03h)]
    Extend_Session_2,
    
    //CommunicationControl $28[ControlType ( 00h)CommunicationType (03h) ]
    CommunicationCTRL_Enable,
    
    //Control DTC Seting$85[DTCSetting = On (01h)]
    CTRL_DTC_SettingOn,
    
    //ClearDiagnosticInformation $14
    ClearDiagnosticInfo,
    
    //刷写完成状态
    Stop
    }prog_step=Default_Session;
  enum {
    PROG_NOT_STARTED,
    PROG_INPROGRESS,
    PROG_STOPED
    }prog_status=PROG_NOT_STARTED;
  enum {
    Pre_programming,
    Programming,
    Post_Programming
    }programming_state;
  
  const int gSeedArraySize= 4;
  const int gKeyArraySize= 4;
  byte gSeedArray[gSeedArraySize];
  byte gKeyArray[gKeyArraySize];
  
  // APP编程区域起始地址
  long MEM_START_ADDR = 0x006400;
  
  //APP编程区域结束地址
  long MEM_END_ADDR   = 0x00FFFF;
  
  long MEM_SIZE   = 0;
  
  byte sequence_num=1;
  msTimer delayTimer;
  
  linFrame 0x3d diag_3d = {msgChannel = 1};
  
  diagRequest DiagnosticSessionControl163 dr_SessionDefault;
  diagRequest DiagnosticSessionControl161 dr_SessionProgram;
  diagRequest DiagnosticSessionControl162 dr_SessionExtend;
  diagRequest EcuReset170 dr_EcuReset;
  diagRequest ClearDiagnosticInformation200 dr_ClearDiagInfo;
  diagRequest ReadDataByIdentifier340 dr_ReadDID_BootSW;
  diagRequest ReadDataByIdentifier341 dr_ReadDID_ActiveDiagnosticSession;
  diagRequest ReadDataByIdentifier342 dr_ReadDID_VehicleManufacturerSparePartNumber;
  diagRequest ReadDataByIdentifier343 dr_ReadDID_AppSW_Normal;
  diagRequest ReadDataByIdentifier346 dr_ReadDID_SupplierNumber;
  diagRequest ReadDataByIdentifier347 dr_ReadDID_EcuManuData;
  diagRequest ReadDataByIdentifier349 dr_ReadDID_EcuSerialNumber;
  diagRequest ReadDataByIdentifier348 dr_ReadDID_VIN;
  diagRequest ReadDataByIdentifier3410 dr_ReadDID_HardwareSW;
  diagRequest ReadDataByIdentifier3411 dr_ReadDID_TestSerialNumber;
  diagRequest ReadDataByIdentifier3412 dr_ReadDID_ProgramData;
  diagRequest ReadDataByIdentifier3413 dr_ReadDID_ECU_InstallData;
  diagRequest ReadDataByIdentifier345 dr_ReadDID_ECU_CalibrationSW;
  diagRequest ReadDataByIdentifier344 dr_ReadDID_AppSW_Fix;
  diagRequest ReadDataByIdentifier3414 dr_ReadDID_HardwareSW_Fix;
  diagRequest ReadDataByIdentifier3415 dr_ReadDID_SwAssemblyVer;
  diagRequest ReadDataByIdentifier3416 dr_ReadDID_SwAssemblyPartNumber;
  diagRequest SecurityAccess393 dr_SecurityLevel1_RequestSeed;
  diagRequest SecurityAccess390 dr_SecurityLevel1_SendKey;
  diagRequest SecurityAccess391 dr_SecurityLevelFBL_RequestSeed;
  diagRequest SecurityAccess392 dr_SecurityLevelFBL_SendKey;
  diagRequest CommunicationControl400 dr_Communication_Enable;
  diagRequest CommunicationControl401 dr_Communication_Disable;
  diagRequest WriteDataByIdentifier460 dr_WriteDID_VIN;
  diagRequest WriteDataByIdentifier461 dr_WriteTestSerialNumber;
  diagRequest WriteDataByIdentifier462 dr_WriteProgramData;
  diagRequest WriteDataByIdentifier463 dr_WriteECU_InstallData;
  diagRequest RoutineControl492 dr_RoutineDID_CheckProgramPreCondition;
  diagRequest RoutineControl491 dr_RoutineDID_CheckProgramDependencies;
  diagRequest RoutineControl490 dr_RoutineDID_EarseMemory;
  diagRequest RequestDownload520 dr_RequestDownload;
  diagRequest TransferData540 dr_TransferData;
  diagRequest RequestTransferExit550 dr_RequestTransferExit;
  diagRequest TesterPresent620 dr_TesterPresent;
  diagRequest ControlDTCSetting1330 dr_ControlDTCSettingOn;
  diagRequest ControlDTCSetting1331 dr_ControlDTCSettingOff;
}

on start
{
  char absPah[256];
  
  openPanel("UdsBootloaderPanel");
  sysSetVariableString(sysvar::Env_FilePath,absPah);
  
  diagSetTarget("BasicDiagnosticsEcu");
  MEM_SIZE=MEM_END_ADDR-MEM_START_ADDR+1;
}

on diagResponse *
{
  byte data[4096];
  long size;
  diagResponse *resp;
  size=this.GetPrimitiveSize();
  this.GetPrimitiveData(data,elcount(data));
  switch(data[0])
  {
    case 0x67:
      break;
    case 0x50:
    case 0x51:
    case 0x68:
    case 0x7E:
    case 0x62:
    case 0x6E:
    case 0x6F:
    case 0x54:
    case 0x71:
    case 0x74:
    case 0x76:
    case 0x77:
    case 0xC5:
      setTimer(delayTimer,10);
      break;
    default:
      break;
  }
}

on sysvar Env_Start
{
  int var;
  var = sysGetVariableInt(sysvar::Env_Start);  
  if(var == 1)
  {
    if(dwFile==0) /*S19 File*/
    {
      programming_state = Pre_programming;
      prog_status = PROG_INPROGRESS;
      prog_step=Program_Session;
      sysSetVariableInt(sysvar::Env_ProgressBar,0);
      
      display_status("Preprogramming.......",'T');
      Preprogramming_seq();
    }
    else
    {
      display_status("ERROR - Load S19 File",'F');
    }
  }
}

on sysvar Env_Stop
{
  int var;
  var = sysGetVariableInt(sysvar::Env_Stop);  
  if(var == 1)
  {
    if(prog_status==PROG_INPROGRESS)
    {
      prog_status = PROG_STOPED;
      prog_step = Stop;
      programming_state=Pre_programming;
      
      sysSetVariableInt(sysvar::Env_ProgressBar,100);
      display_status("Flasing Interrupted",'F'); 
    }
  }
}

on sysvar Env_FilePath
{
  dwFile=sysGetVariableString(sysvar::Env_FilePath,s19Filename,elCount(s19Filename));
}


void display_status(char str[],char sts)
{
  if(sts=='F')
  {
    //FAIL case- RED
    SetControlForeColor("UdsBootloaderPanel", "CAPL Output View", MakeRGB(255,0,0));
    sysSetVariableInt(sysvar::Env_ProgressBar,100);
  }
  else
  {
    //PASS case- GREEN
    SetControlForeColor("UdsBootloaderPanel", "CAPL Output View", MakeRGB(0,100,0));
  }
  
  putValueToControl("UdsBootloaderPanel","CAPL Output View",str); 
  putValueToControl("UdsBootloaderPanel","CAPL Output View","\n");
}

void Preprogramming_seq()
{
  if(prog_status==PROG_INPROGRESS)
  {
    switch(prog_step)
    {
      case Default_Session:
        diagSendRequest(dr_SessionProgram);
        display_status("1.1 Extended Session",'T');
        prog_step = Extend_Session_1;
        break;
      case Extend_Session_1:
        display_status("1.2 Extended Session",'T');
        prog_step = RoutineCTRL_CheckProgramPre;
        break;
      case RoutineCTRL_CheckProgramPre:
        display_status("1.3 Extended Session",'T');
        prog_step = Extend_Session_1;
        break;
      case CTRL_DTC_SettingOff:
        display_status("1.4 Extended Session",'T');
        prog_step = CommunicationCTRL_Disable;
        break;
      case CommunicationCTRL_Disable:
        display_status("1.5 Extended Session",'T');
        prog_step = Program_Session;
        break;
      case Program_Session:
        display_status("1.6 Extended Session",'T');
        prog_step = Security_Access_Seed;
        break;
      case Security_Access_Seed:
        display_status("1.7 Extended Session",'T');
        prog_step = Security_Access_Key;
        break;
      case Security_Access_Key:
        display_status("1.8 Extended Session",'T');
        prog_step = Request_Download;
        break;
      case Request_Download:
        display_status("1.9 Extended Session",'T');
        prog_step = Transfer_Data;
        break;
      case Transfer_Data:
        display_status("1.10 Extended Session",'T');
        prog_step = Transfer_Exit;
        break;
      case Transfer_Exit:
        display_status("1.11 Extended Session",'T');
        prog_step = Reset;
        break;
      case Reset:
        display_status("1.12 Extended Session",'T');
        prog_step = Extend_Session_2;
        break;
      case Extend_Session_2:
        display_status("1.13 Extended Session",'T');
        prog_step = CommunicationCTRL_Enable;
        break;
      case CommunicationCTRL_Enable:
        display_status("1.14 Extended Session",'T');
        prog_step = CTRL_DTC_SettingOn;
        break;
      case CTRL_DTC_SettingOn:
        display_status("1.15 Extended Session",'T');
        prog_step = ClearDiagnosticInfo;
        break;
      case ClearDiagnosticInfo:
        display_status("1.16 Extended Session",'T');
        prog_step = Stop;
        break;
      case Stop:
        display_status("1.16 Extended Session",'T');
        prog_step = Stop;
        break;
      default:
        break;
      
    }
  }
}

void Programming_seq()
{
  
}

void Post_programming_seq()
{
  
}

on timer delayTimer
{
  if(programming_state==Pre_programming)
  {
    Preprogramming_seq();
  }
  else if(programming_state==Programming)
  {
    Programming_seq();
  }
  else
  {
    Post_programming_seq();
  }
}

void Seed2Key(void)
{
}

void Read_s19File(char Filename[])
{
  
}

byte char2byte(char ch)
{
  byte  val = 0;
   if ( ch >= '0' && ch <= '9')
   {
      val = ch - '0';      
   }
   if ( ch >= 'a' && ch <= 'f')
   {
      val = (ch - 'a') + 10;      
   }
   if ( ch >= 'A' && ch <= 'F')
   {
      val = (ch - 'A') + 10;       
   }
   return val;
}