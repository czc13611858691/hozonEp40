/*@!Encoding:936*/
includes
{
  
}

variables
{
  linFrame 0x3C diag_3c = {msgChannel = 1};
  linFrame 0x3d diag_3d = {msgChannel = 1};

  //LIN
  
  msTimer tmr1;
  
  int frame_count = 0;
  int autoAddrNum = 0;
  int startPIDNum = 0;
  int change_color_flg=0;
  int change_level_flg=0;
  int frame_0x2_flg=0;
  int frame_0x3_flg=0;
  int frame_0x6_flg=0;
  int frame_count_0_last=0;
  byte product_Nad = 0x50;
  byte PID_table[15] = {0x50,0x11,0x92,0xd3,0x14,0x55,0xd6,0x97,0xd8,0x99,0x1a,0x5b,0x9c,0xdd,0x5e};
  byte config_table[15] = {0x42,0x42,0x42,0x03,0x03,0x03,0xc4,0xc4,0xc4,0x85,0x85,0x85,0x06,0x06,0x06};
  int level=0;
  int color=0;
  int cnt=0;
  
  byte soft_version[8];
  byte bootloader_version[8];
  byte hardware_version[5];
  byte diagnost_version[1];
  byte vehicle_part_no[13];
  byte software_version_fixed[8];
  byte ecu_calibration_number[8];
  byte system_supplier_code[3];
  byte ecu_production_date[4];
  byte ctrl_serial_number[18];
  byte vehicle_VIN[17];
  byte test_serial_no[10];
  byte update_date[4];
  byte ecu_assembly_date[4];
  
  byte hardware_version_no[5];
  byte software_assembly[8];
  byte software_assembly_part_no[13];
  int block_count = 0;  //固件大小，分区数目，一个分区4096byte，这个要根据芯片的配置做调整
  int block_tran_index = 0;
  long program_size = 0;
  long byte_tran_index = 0;
  int block_data_index = 0;
  byte bin_buf[1024*128]; //32K缓冲区
  char file_name[1024];
  char file_path[1024];
  byte frame_countinus_count=0;
  int current_transfer_len=0;
  long temp_compu;
  byte program_data_size[5]; 
  byte crc16_pro[2];
  
  word crctab[256] = {
    0x0000, 0x1021, 0x2042, 0x3063, 0x4084, 0x50A5, 0x60C6, 0x70E7,
    0x8108, 0x9129, 0xA14A, 0xB16B, 0xC18C, 0xD1AD, 0xE1CE, 0xF1EF,
    0x1231, 0x0210, 0x3273, 0x2252, 0x52B5, 0x4294, 0x72F7, 0x62D6,
    0x9339, 0x8318, 0xB37B, 0xA35A, 0xD3BD, 0xC39C, 0xF3FF, 0xE3DE,
    0x2462, 0x3443, 0x0420, 0x1401, 0x64E6, 0x74C7, 0x44A4, 0x5485,
    0xA56A, 0xB54B, 0x8528, 0x9509, 0xE5EE, 0xF5CF, 0xC5AC, 0xD58D,
    0x3653, 0x2672, 0x1611, 0x0630, 0x76D7, 0x66F6, 0x5695, 0x46B4,
    0xB75B, 0xA77A, 0x9719, 0x8738, 0xF7DF, 0xE7FE, 0xD79D, 0xC7BC,
    0x48C4, 0x58E5, 0x6886, 0x78A7, 0x0840, 0x1861, 0x2802, 0x3823,
    0xC9CC, 0xD9ED, 0xE98E, 0xF9AF, 0x8948, 0x9969, 0xA90A, 0xB92B,
    0x5AF5, 0x4AD4, 0x7AB7, 0x6A96, 0x1A71, 0x0A50, 0x3A33, 0x2A12,
    0xDBFD, 0xCBDC, 0xFBBF, 0xEB9E, 0x9B79, 0x8B58, 0xBB3B, 0xAB1A,
    0x6CA6, 0x7C87, 0x4CE4, 0x5CC5, 0x2C22, 0x3C03, 0x0C60, 0x1C41,
    0xEDAE, 0xFD8F, 0xCDEC, 0xDDCD, 0xAD2A, 0xBD0B, 0x8D68, 0x9D49,
    0x7E97, 0x6EB6, 0x5ED5, 0x4EF4, 0x3E13, 0x2E32, 0x1E51, 0x0E70,
    0xFF9F, 0xEFBE, 0xDFDD, 0xCFFC, 0xBF1B, 0xAF3A, 0x9F59, 0x8F78,
    0x9188, 0x81A9, 0xB1CA, 0xA1EB, 0xD10C, 0xC12D, 0xF14E, 0xE16F,
    0x1080, 0x00A1, 0x30C2, 0x20E3, 0x5004, 0x4025, 0x7046, 0x6067,
    0x83B9, 0x9398, 0xA3FB, 0xB3DA, 0xC33D, 0xD31C, 0xE37F, 0xF35E,
    0x02B1, 0x1290, 0x22F3, 0x32D2, 0x4235, 0x5214, 0x6277, 0x7256,
    0xB5EA, 0xA5CB, 0x95A8, 0x8589, 0xF56E, 0xE54F, 0xD52C, 0xC50D,
    0x34E2, 0x24C3, 0x14A0, 0x0481, 0x7466, 0x6447, 0x5424, 0x4405,
    0xA7DB, 0xB7FA, 0x8799, 0x97B8, 0xE75F, 0xF77E, 0xC71D, 0xD73C,
    0x26D3, 0x36F2, 0x0691, 0x16B0, 0x6657, 0x7676, 0x4615, 0x5634,
    0xD94C, 0xC96D, 0xF90E, 0xE92F, 0x99C8, 0x89E9, 0xB98A, 0xA9AB,
    0x5844, 0x4865, 0x7806, 0x6827, 0x18C0, 0x08E1, 0x3882, 0x28A3,
    0xCB7D, 0xDB5C, 0xEB3F, 0xFB1E, 0x8BF9, 0x9BD8, 0xABBB, 0xBB9A,
    0x4A75, 0x5A54, 0x6A37, 0x7A16, 0x0AF1, 0x1AD0, 0x2AB3, 0x3A92,
    0xFD2E, 0xED0F, 0xDD6C, 0xCD4D, 0xBDAA, 0xAD8B, 0x9DE8, 0x8DC9,
    0x7C26, 0x6C07, 0x5C64, 0x4C45, 0x3CA2, 0x2C83, 0x1CE0, 0x0CC1,
    0xEF1F, 0xFF3E, 0xCF5D, 0xDF7C, 0xAF9B, 0xBFBA, 0x8FD9, 0x9FF8,
    0x6E17, 0x7E36, 0x4E55, 0x5E74, 0x2E93, 0x3EB2, 0x0ED1, 0x1EF0
  };
 
}

on key 'a'
{
  linStopScheduler();
  traceWindowClear("Trace");
}

on key 's'
{
  linStartScheduler();
}

on sysvar User::btn_ctrl_nad
{
  int var;
  var = sysGetVariableInt(sysvar::User::btn_ctrl_nad);  
  if(var == 0)
  {
    product_Nad = 0x50;
  }else if(var==1)
  {
    product_Nad = 0x51;
  }else if(var==2)
  {
    product_Nad = 0x60;
  }else if(var==3)
  {
    product_Nad = 0x61;
  }
}

on sysvar Sch::start_table
{
  int var;
  var = sysGetVariableInt(sysvar::Sch::start_table);  
  if(var == 1)
  {
    linStartScheduler();
  }
}

on sysvar Sch::stop_table
{
  int var;
  var = sysGetVariableInt(sysvar::Sch::stop_table);  
  if(var == 1)
  {
    linStopScheduler();
  }
}

on start
{
  diag_3c.msgChannel = 1;
  frame_count = 0;
  setTimer(tmr1,20);
}

on timer tmr1
{
  switch(frame_count)
  {
    case 1:
      frame_count++;
      diag_3c.rtr = 0;
      diag_3c.byte(0) = product_Nad;
      diag_3c.byte(1) = 2;
      diag_3c.byte(2) = 0x10;
      diag_3c.byte(3) = 1;
      diag_3c.byte(4) = 255;
      diag_3c.byte(5) = 255;
      diag_3c.byte(6) = 255;
      diag_3c.byte(7) = 255;
      output(diag_3c);
      diag_3c.rtr = 1;
      output(diag_3c);
      write("DiagnosticSessionControl$10[01]");
      break;
    case 2:
      frame_count++;
      diag_3d.rtr = 1;
      output(diag_3d);
      break;
    case 3:
      //读取bootloader软件版本号
      frame_count++;
      diag_3c.rtr = 0;
      diag_3c.byte(0) = product_Nad;
      diag_3c.byte(1) = 3;
      diag_3c.byte(2) = 0x22;
      diag_3c.byte(3) = 0xf1;
      diag_3c.byte(4) = 0x80;
      diag_3c.byte(5) = 255;
      diag_3c.byte(6) = 255;
      diag_3c.byte(7) = 255;
      output(diag_3c);
      diag_3c.rtr = 1;
      output(diag_3c);
      break;
    case 4:      
      frame_count++;
      diag_3d.rtr = 1;
      output(diag_3d);
      break;
    case 5:      
      frame_count++;
      diag_3d.rtr = 1;
      output(diag_3d);
      break;
    case 6:
      //读取app软件版本号
      frame_count++;
      diag_3c.rtr = 0;
      diag_3c.byte(0) = product_Nad;
      diag_3c.byte(1) = 3;
      diag_3c.byte(2) = 0x22;
      diag_3c.byte(3) = 0xf1;
      diag_3c.byte(4) = 0x88;
      diag_3c.byte(5) = 255;
      diag_3c.byte(6) = 255;
      diag_3c.byte(7) = 255;
      output(diag_3c);
      diag_3c.rtr = 1;
      output(diag_3c);
      break;
    case 7:      
      frame_count++;
      diag_3d.rtr = 1;
      output(diag_3d);
      break;
    case 8:      
      frame_count++;
      diag_3d.rtr = 1;
      output(diag_3d);
      break;
    case 9:
      //读取VIN
      frame_count++;
      diag_3c.rtr = 0;
      diag_3c.byte(0) = product_Nad;
      diag_3c.byte(1) = 3;
      diag_3c.byte(2) = 0x22;
      diag_3c.byte(3) = 0xf1;
      diag_3c.byte(4) = 0x90;
      diag_3c.byte(5) = 255;
      diag_3c.byte(6) = 255;
      diag_3c.byte(7) = 255;
      output(diag_3c);
      diag_3c.rtr = 1;
      output(diag_3c);
      break;
    case 10:      
      frame_count++;
      diag_3d.rtr = 1;
      output(diag_3d);
      break;
    case 11:      
      frame_count++;
      diag_3d.rtr = 1;
      output(diag_3d);
      break;
    case 12:      
      frame_count++;
      diag_3d.rtr = 1;
      output(diag_3d);
      break;
    case 13:      
      frame_count++;
      diag_3d.rtr = 1;
      output(diag_3d);
      break;
    case 14:
      //读取ecu硬件版本号
      frame_count++;
      diag_3c.rtr = 0;
      diag_3c.byte(0) = product_Nad;
      diag_3c.byte(1) = 3;
      diag_3c.byte(2) = 0x22;
      diag_3c.byte(3) = 0xf1;
      diag_3c.byte(4) = 0x91;
      diag_3c.byte(5) = 255;
      diag_3c.byte(6) = 255;
      diag_3c.byte(7) = 255;
      output(diag_3c);
      diag_3c.rtr = 1;
      output(diag_3c);
      break;
    case 15:      
      frame_count++;
      diag_3d.rtr = 1;
      output(diag_3d);
      break;
    case 16:  
      //frame_count_0_last=16;    
      frame_count=310;
      diag_3d.rtr = 1;
      output(diag_3d);
      break;
    case 310:
      //当前诊断任务模式
      frame_count++;
      diag_3c.rtr = 0;
      diag_3c.byte(0) = product_Nad;
      diag_3c.byte(1) = 3;
      diag_3c.byte(2) = 0x22;
      diag_3c.byte(3) = 0xf1;
      diag_3c.byte(4) = 0x86;
      diag_3c.byte(5) = 255;
      diag_3c.byte(6) = 255;
      diag_3c.byte(7) = 255;
      output(diag_3c);
      diag_3c.rtr = 1;
      output(diag_3c);
    break;
    case 311:      
      frame_count++;
      diag_3d.rtr = 1;
      output(diag_3d);
    break;
    case 312:
      //整车零部件号
      frame_count++;
      diag_3c.rtr = 0;
      diag_3c.byte(0) = product_Nad;
      diag_3c.byte(1) = 3;
      diag_3c.byte(2) = 0x22;
      diag_3c.byte(3) = 0xf1;
      diag_3c.byte(4) = 0x87;
      diag_3c.byte(5) = 255;
      diag_3c.byte(6) = 255;
      diag_3c.byte(7) = 255;
      output(diag_3c);
      diag_3c.rtr = 1;
      output(diag_3c);
    break;
    case 313:      
      frame_count++;
      diag_3d.rtr = 1;
      output(diag_3d);
    break;
    case 314:      
      frame_count++;
      diag_3d.rtr = 1;
      output(diag_3d);
    break;
    case 315:      
      frame_count=317;
      diag_3d.rtr = 1;
      output(diag_3d);
    break;
    case 317:
      //应用软件版本号(固定版本）
      frame_count++;
      diag_3c.rtr = 0;
      diag_3c.byte(0) = product_Nad;
      diag_3c.byte(1) = 3;
      diag_3c.byte(2) = 0x22;
      diag_3c.byte(3) = 0xf1;
      diag_3c.byte(4) = 0xB0;
      diag_3c.byte(5) = 255;
      diag_3c.byte(6) = 255;
      diag_3c.byte(7) = 255;
      output(diag_3c);
      diag_3c.rtr = 1;
      output(diag_3c);
    break;
    case 318:      
      frame_count++;
      diag_3d.rtr = 1;
      output(diag_3d);
    break;
    case 319:      
      frame_count++;
      diag_3d.rtr = 1;
      output(diag_3d);
    break;
    case 320:
      //ECU标定软件号
      frame_count++;
      diag_3c.rtr = 0;
      diag_3c.byte(0) = product_Nad;
      diag_3c.byte(1) = 3;
      diag_3c.byte(2) = 0x22;
      diag_3c.byte(3) = 0xf1;
      diag_3c.byte(4) = 0xA2;
      diag_3c.byte(5) = 255;
      diag_3c.byte(6) = 255;
      diag_3c.byte(7) = 255;
      output(diag_3c);
      diag_3c.rtr = 1;
      output(diag_3c);
    break;
    case 321:      
      frame_count++;
      diag_3d.rtr = 1;
      output(diag_3d);
    break;
    case 322:      
      frame_count++;
      diag_3d.rtr = 1;
      output(diag_3d);
    break;
    case 323:
      //系统供应商代码
      frame_count++;
      diag_3c.rtr = 0;
      diag_3c.byte(0) = product_Nad;
      diag_3c.byte(1) = 3;
      diag_3c.byte(2) = 0x22;
      diag_3c.byte(3) = 0xf1;
      diag_3c.byte(4) = 0x8A;
      diag_3c.byte(5) = 255;
      diag_3c.byte(6) = 255;
      diag_3c.byte(7) = 255;
      output(diag_3c);
      diag_3c.rtr = 1;
      output(diag_3c);
    break;
    case 324:      
      frame_count++;
      diag_3d.rtr = 1;
      output(diag_3d);
    break;
    case 325:      
      frame_count++;
      diag_3d.rtr = 1;
      output(diag_3d);
    break;
    case 326:
      //ECU生产日期
      frame_count++;
      diag_3c.rtr = 0;
      diag_3c.byte(0) = product_Nad;
      diag_3c.byte(1) = 3;
      diag_3c.byte(2) = 0x22;
      diag_3c.byte(3) = 0xf1;
      diag_3c.byte(4) = 0x8B;
      diag_3c.byte(5) = 255;
      diag_3c.byte(6) = 255;
      diag_3c.byte(7) = 255;
      output(diag_3c);
      diag_3c.rtr = 1;
      output(diag_3c);
    break;
    case 327:      
      frame_count++;
      diag_3d.rtr = 1;
      output(diag_3d);
    break;
    case 328:      
      frame_count++;
      diag_3d.rtr = 1;
      output(diag_3d);
    break;
    case 329:
      //控制器序列号
      frame_count++;
      diag_3c.rtr = 0;
      diag_3c.byte(0) = product_Nad;
      diag_3c.byte(1) = 3;
      diag_3c.byte(2) = 0x22;
      diag_3c.byte(3) = 0xf1;
      diag_3c.byte(4) = 0x8C;
      diag_3c.byte(5) = 255;
      diag_3c.byte(6) = 255;
      diag_3c.byte(7) = 255;
      output(diag_3c);
      diag_3c.rtr = 1;
      output(diag_3c);
    break;
    case 330:      
      frame_count++;
      diag_3d.rtr = 1;
      output(diag_3d);
    break;
    case 331:      
      frame_count++;
      diag_3d.rtr = 1;
      output(diag_3d);
    break;
    case 332:      
      frame_count++;
      diag_3d.rtr = 1;
      output(diag_3d);
    break;
    case 333:      
      frame_count++;
      diag_3d.rtr = 1;
      output(diag_3d);
    break;
    case 334:
      //测试串口序列
      frame_count++;
      diag_3c.rtr = 0;
      diag_3c.byte(0) = product_Nad;
      diag_3c.byte(1) = 3;
      diag_3c.byte(2) = 0x22;
      diag_3c.byte(3) = 0xf1;
      diag_3c.byte(4) = 0x98;
      diag_3c.byte(5) = 255;
      diag_3c.byte(6) = 255;
      diag_3c.byte(7) = 255;
      output(diag_3c);
      diag_3c.rtr = 1;
      output(diag_3c);
    break;
    case 335:      
      frame_count++;
      diag_3d.rtr = 1;
      output(diag_3d);
    break;
    case 336:      
      frame_count++;
      diag_3d.rtr = 1;
      output(diag_3d);
    break;
    case 337:      
      frame_count++;
      diag_3d.rtr = 1;
      output(diag_3d);
    break;
    case 338:
      //刷新日期
      frame_count++;
      diag_3c.rtr = 0;
      diag_3c.byte(0) = product_Nad;
      diag_3c.byte(1) = 3;
      diag_3c.byte(2) = 0x22;
      diag_3c.byte(3) = 0xf1;
      diag_3c.byte(4) = 0x99;
      diag_3c.byte(5) = 255;
      diag_3c.byte(6) = 255;
      diag_3c.byte(7) = 255;
      output(diag_3c);
      diag_3c.rtr = 1;
      output(diag_3c);
    break;
    case 339:      
      frame_count++;
      diag_3d.rtr = 1;
      output(diag_3d);
    break;
    case 340:      
      frame_count++;
      diag_3d.rtr = 1;
      output(diag_3d);
    break;
    case 341:
      //ECU装配日期
      frame_count++;
      diag_3c.rtr = 0;
      diag_3c.byte(0) = product_Nad;
      diag_3c.byte(1) = 3;
      diag_3c.byte(2) = 0x22;
      diag_3c.byte(3) = 0xf1;
      diag_3c.byte(4) = 0x9D;
      diag_3c.byte(5) = 255;
      diag_3c.byte(6) = 255;
      diag_3c.byte(7) = 255;
      output(diag_3c);
      diag_3c.rtr = 1;
      output(diag_3c);
    break;
    case 342:      
      frame_count++;
      diag_3d.rtr = 1;
      output(diag_3d);
    break;
    case 343:      
      frame_count++;
      diag_3d.rtr = 1;
      output(diag_3d);
    break;
    case 344:
      //硬件版本
      frame_count++;
      diag_3c.rtr = 0;
      diag_3c.byte(0) = product_Nad;
      diag_3c.byte(1) = 3;
      diag_3c.byte(2) = 0x22;
      diag_3c.byte(3) = 0xf1;
      diag_3c.byte(4) = 0xBF;
      diag_3c.byte(5) = 255;
      diag_3c.byte(6) = 255;
      diag_3c.byte(7) = 255;
      output(diag_3c);
      diag_3c.rtr = 1;
      output(diag_3c);
    break;
    case 345:      
      frame_count++;
      diag_3d.rtr = 1;
      output(diag_3d);
    break;
    case 346:      
      frame_count++;
      diag_3d.rtr = 1;
      output(diag_3d);
    break;
    case 347:
      //软件总成
      frame_count++;
      diag_3c.rtr = 0;
      diag_3c.byte(0) = product_Nad;
      diag_3c.byte(1) = 3;
      diag_3c.byte(2) = 0x22;
      diag_3c.byte(3) = 0xf1;
      diag_3c.byte(4) = 0xC0;
      diag_3c.byte(5) = 255;
      diag_3c.byte(6) = 255;
      diag_3c.byte(7) = 255;
      output(diag_3c);
      diag_3c.rtr = 1;
      output(diag_3c);
    break;
    case 348:      
      frame_count++;
      diag_3d.rtr = 1;
      output(diag_3d);
    break;
    case 349:      
      frame_count++;
      diag_3d.rtr = 1;
      output(diag_3d);
    break;
    case 350:
      //软件总成零件号
      frame_count++;
      diag_3c.rtr = 0;
      diag_3c.byte(0) = product_Nad;
      diag_3c.byte(1) = 3;
      diag_3c.byte(2) = 0x22;
      diag_3c.byte(3) = 0xf1;
      diag_3c.byte(4) = 0xD0;
      diag_3c.byte(5) = 255;
      diag_3c.byte(6) = 255;
      diag_3c.byte(7) = 255;
      output(diag_3c);
      diag_3c.rtr = 1;
      output(diag_3c);
    break;
    case 351:      
      frame_count++;
      diag_3d.rtr = 1;
      output(diag_3d);
    break;
    case 352:      
      frame_count++;
      diag_3d.rtr = 1;
      output(diag_3d);
    break;
    case 353:      
      frame_count_0_last=353;    
      frame_count=0;
      diag_3d.rtr = 1;
      output(diag_3d);
    break;
    case 17:
      //进入扩展会话
      frame_count++;
      diag_3c.rtr = 0;
      diag_3c.byte(0) = product_Nad;
      diag_3c.byte(1) = 2;
      diag_3c.byte(2) = 0x10;
      diag_3c.byte(3) = 3;
      diag_3c.byte(4) = 255;
      diag_3c.byte(5) = 255;
      diag_3c.byte(6) = 255;
      diag_3c.byte(7) = 255;
      output(diag_3c);
      diag_3c.rtr = 1;
      output(diag_3c);
      break;
    case 18:
      frame_count++;
      diag_3d.rtr = 1;
      output(diag_3d);      
      break;
    case 19:
      //执行检查程序安全状态
      frame_count++;
      diag_3c.rtr = 0;
      diag_3c.byte(0) = product_Nad;
      diag_3c.byte(1) = 4;
      diag_3c.byte(2) = 0x31;
      diag_3c.byte(3) = 0x01;
      diag_3c.byte(4) = 0x02;
      diag_3c.byte(5) = 0x03;
      diag_3c.byte(6) = 255;
      diag_3c.byte(7) = 255;
      output(diag_3c);
      diag_3c.rtr = 1;
      output(diag_3c);     
      break;
    case 20:
      frame_count++;
      diag_3d.rtr = 1;
      output(diag_3d); 
      break;
    case 21:
      //获取安全状态检查结果
      frame_count++;
      diag_3c.rtr = 0;
      diag_3c.byte(0) = product_Nad;
      diag_3c.byte(1) = 4;
      diag_3c.byte(2) = 0x31;
      diag_3c.byte(3) = 0x03;
      diag_3c.byte(4) = 0x02;
      diag_3c.byte(5) = 0x03;
      diag_3c.byte(6) = 255;
      diag_3c.byte(7) = 255;
      output(diag_3c);
      diag_3c.rtr = 1;
      output(diag_3c);     
      break;
    case 22:
      frame_count++;
      diag_3d.rtr = 1;
      output(diag_3d); 
      break;      
    case 24:
      //设置DTC功能关闭
      frame_count++;
      diag_3c.rtr = 0;
      diag_3c.byte(0) = product_Nad;
      diag_3c.byte(1) = 2;
      diag_3c.byte(2) = 0x85;
      diag_3c.byte(3) = 0x02;
      diag_3c.byte(4) = 0xff;
      diag_3c.byte(5) = 0xff;
      diag_3c.byte(6) = 255;
      diag_3c.byte(7) = 255;
      output(diag_3c);
      diag_3c.rtr = 1;
      output(diag_3c);         
      break;
    case 25:
      frame_count++;
      diag_3d.rtr = 1;
      output(diag_3d); 
    case 26:
      //设置DTC功能关闭
      frame_count++;
      diag_3c.rtr = 0;
      diag_3c.byte(0) = product_Nad;
      diag_3c.byte(1) = 3;
      diag_3c.byte(2) = 0x28;
      diag_3c.byte(3) = 0x03;
      diag_3c.byte(4) = 0x03;
      diag_3c.byte(5) = 0xff;
      diag_3c.byte(6) = 255;
      diag_3c.byte(7) = 255;
      output(diag_3c);
      diag_3c.rtr = 1;
      output(diag_3c);         
      break;
    case 27:
      frame_count++;
      diag_3d.rtr = 1;
      output(diag_3d); 
      break;
    case 90:
      frame_count++;
      diag_3c.rtr = 0;
      diag_3c.byte(0) = product_Nad;
      diag_3c.byte(1) = 0x10;
      diag_3c.byte(2) = 0x0b;
      diag_3c.byte(3) = 0x34;
      diag_3c.byte(4) = 0x0;
      diag_3c.byte(5) = 0x44;
      diag_3c.byte(6) = 0x00;
      diag_3c.byte(7) = 0x00;
      output(diag_3c);
      diag_3c.rtr = 1;
      output(diag_3c); 
      break;
    case 91:
      frame_count++;
      diag_3c.rtr = 0;
      diag_3c.byte(0) = product_Nad;
      diag_3c.byte(1) = 0x21;
      diag_3c.byte(2) = 0x48;
      diag_3c.byte(3) = 0x00;
      diag_3c.byte(4) = program_data_size[0];
      diag_3c.byte(5) = program_data_size[1];
      diag_3c.byte(6) = program_data_size[2];
      diag_3c.byte(7) = program_data_size[3];
      output(diag_3c);
      diag_3c.rtr = 1;
      output(diag_3c);
      break;
    case 92:
      frame_count=0;
      diag_3d.rtr = 1;
      output(diag_3d); 
      break;
    case 101:
      //进入编程会话
      frame_count++;
      diag_3c.rtr = 0;
      diag_3c.byte(0) = product_Nad;
      diag_3c.byte(1) = 2;
      diag_3c.byte(2) = 0x10;
      diag_3c.byte(3) = 2;
      diag_3c.byte(4) = 255;
      diag_3c.byte(5) = 255;
      diag_3c.byte(6) = 255;
      diag_3c.byte(7) = 255;
      output(diag_3c);
      diag_3c.rtr = 1;
      output(diag_3c);      
      break;
    case 102:
      frame_count=0;
      diag_3d.rtr = 1;
      output(diag_3d); 
      break;
    case 103:
      //请求密钥的种子信息
      frame_count++;
      diag_3c.rtr = 0;
      diag_3c.byte(0) = product_Nad;
      diag_3c.byte(1) = 2;
      diag_3c.byte(2) = 0x27;
      diag_3c.byte(3) = 0x11;
      diag_3c.byte(4) = 255;
      diag_3c.byte(5) = 255;
      diag_3c.byte(6) = 255;
      diag_3c.byte(7) = 255;
      output(diag_3c);
      diag_3c.rtr = 1;
      output(diag_3c);      
      break;
    case 104:
      //这里需要单独判断返回数据种子明文的数据长度
      frame_count++;
      diag_3d.rtr = 1;
      output(diag_3d); 
      break;
    case 106:
      //发送密钥的密码信息,发送数据的长度取决于种子数据长度
      frame_count++;
      diag_3c.rtr = 0;
      diag_3c.byte(0) = product_Nad;
      diag_3c.byte(1) = 0x6;
      diag_3c.byte(2) = 0x27;
      diag_3c.byte(3) = 0x12;
      diag_3c.byte(4) = 4;
      diag_3c.byte(5) = 3;
      diag_3c.byte(6) = 2;
      diag_3c.byte(7) = 1;
      output(diag_3c);
      diag_3c.rtr = 1;
      output(diag_3c);      
      break; 
    case 107:
      //这里如果获得肯定响应信息,就是授权OK
      frame_count=0;
      diag_3d.rtr = 1;
      output(diag_3d); 
      break; 
    case 108:
      //写入程序相关信息
      break;
    case 109:
      break;
    case 111:
      //擦除内存开始请求信息首帧
      frame_count++;
      diag_3c.rtr = 0;
      diag_3c.byte(0) = product_Nad;
      diag_3c.byte(1) = 0x10;
      diag_3c.byte(2) = 0x0c;
      diag_3c.byte(3) = 0x31;
      diag_3c.byte(4) = 0x01;
      diag_3c.byte(5) = 0xff;
      diag_3c.byte(6) = 0x00;
      diag_3c.byte(7) = 255;
      output(diag_3c);
      diag_3c.rtr = 1;
      output(diag_3c);  
      break;
    case 112:
      //擦除内存开始请求信息第二帧
      frame_count++;
      diag_3c.rtr = 0;
      diag_3c.byte(0) = product_Nad;
      diag_3c.byte(1) = 0x21;
      diag_3c.byte(2) = 0xff;
      diag_3c.byte(3) = 0xff;
      diag_3c.byte(4) = 0xff;
      diag_3c.byte(5) = 0xff;
      diag_3c.byte(6) = 0xff;
      diag_3c.byte(7) = 0xff;
      output(diag_3c);
      diag_3c.rtr = 1;
      output(diag_3c);  
      break;
    case 113:
      //擦除内存开始请求信息第三帧
      frame_count++;
      diag_3c.rtr = 0;
      diag_3c.byte(0) = product_Nad;
      diag_3c.byte(1) = 0x22;
      diag_3c.byte(2) = 0xff;
      diag_3c.byte(3) = 0xff;
      diag_3c.byte(4) = 0xff;
      diag_3c.byte(5) = 0xff;
      diag_3c.byte(6) = 0xff;
      diag_3c.byte(7) = 0xff;
      output(diag_3c);
      diag_3c.rtr = 1;
      output(diag_3c);  
      break;
    case 114:
      frame_count=0;
      diag_3d.rtr = 1;
      output(diag_3d);       
      break;
    case 115:
      frame_count++;
      diag_3c.rtr = 0;
      diag_3c.byte(0) = product_Nad;
      diag_3c.byte(1) = 4;
      diag_3c.byte(2) = 0x31;
      diag_3c.byte(3) = 0x03;
      diag_3c.byte(4) = 0xff;
      diag_3c.byte(5) = 0x00;
      diag_3c.byte(6) = 0xff;
      diag_3c.byte(7) = 0xff;
      output(diag_3c);
      diag_3c.rtr = 1;
      output(diag_3c);  
      break;
    case 116:
      frame_count=0;
      diag_3d.rtr = 1;
      output(diag_3d);       
      break;
      
    case 201://传输数据
      if(block_tran_index <= block_count)
      {
        if(block_data_index == 0)//首帧
        {
          diag_3c.rtr = 0;
          diag_3c.byte(0) = product_Nad;
          diag_3c.byte(1) = 0x10; //首帧
          temp_compu = program_size - byte_tran_index;
          if(temp_compu >= 64)
          {
            temp_compu = 64;
            diag_3c.byte(2) = 0x42; //数据长度66
          }
          else
            diag_3c.byte(2) = temp_compu + 2; //数据长度66
          diag_3c.byte(3) = 0x36;
          diag_3c.byte(4) = block_tran_index; //块计数
          diag_3c.byte(5) = bin_buf[byte_tran_index++];
          diag_3c.byte(6) = bin_buf[byte_tran_index++];
          diag_3c.byte(7) = bin_buf[byte_tran_index++];
          output(diag_3c);
          diag_3c.rtr = 1;
          output(diag_3c); 
          frame_countinus_count++;
          block_data_index+=3;
        }else
        {
          diag_3c.rtr = 0;
          diag_3c.byte(0) = product_Nad;
          diag_3c.byte(1) = (frame_countinus_count&0x0f)|0x20; //连续帧
          if(block_data_index < temp_compu)
          {
            block_data_index++;
            diag_3c.byte(2) = bin_buf[byte_tran_index++];
          }
          else 
            diag_3c.byte(2) = 255;
          
          if(block_data_index < temp_compu)
          {
             block_data_index++;
            diag_3c.byte(3) = bin_buf[byte_tran_index++];
          }
          else 
            diag_3c.byte(3) = 255;      
          
          if(block_data_index < temp_compu)
          {
            block_data_index++;
            diag_3c.byte(4) = bin_buf[byte_tran_index++];
          }
          else 
            diag_3c.byte(4) = 255;   
          
          if(block_data_index < temp_compu)
          {
            block_data_index++;
            diag_3c.byte(5) = bin_buf[byte_tran_index++];
          }
          else 
            diag_3c.byte(5) = 255;
          
          if(block_data_index < temp_compu)
          {
            block_data_index++;
            diag_3c.byte(6) = bin_buf[byte_tran_index++];
          }
          else 
            diag_3c.byte(6) = 255;          
          
          if(block_data_index < temp_compu)
          {
             block_data_index++;
            diag_3c.byte(7) = bin_buf[byte_tran_index++];   
          }
          else 
            diag_3c.byte(7) = 255;
          
          output(diag_3c);
          diag_3c.rtr = 1;
          output(diag_3c); 
          frame_countinus_count++;
        }
        if(block_data_index >= temp_compu)
        {
          frame_count++;
          block_tran_index++;
          block_data_index = 0;
          frame_countinus_count = 0;
        }
      }
      break;
     case 202:
      frame_count++;
      diag_3d.rtr = 1;
      output(diag_3d);   
      break;
     case 204:  //退出下载
      traceWindowClear("Trace");
      frame_count++;
      diag_3c.rtr = 0;
      diag_3c.byte(0) = product_Nad;
      diag_3c.byte(1) = 1;
      diag_3c.byte(2) = 0x37;
      diag_3c.byte(3) = 0xff;
      diag_3c.byte(4) = 0xff;
      diag_3c.byte(5) = 0xff;
      diag_3c.byte(6) = 0xff;
      diag_3c.byte(7) = 0xff;
      output(diag_3c);
      diag_3c.rtr = 1;
      output(diag_3c);
      break;
     case 205:
      frame_count=0;
      diag_3d.rtr = 1;
      output(diag_3d);      
      break;
     case 206: //运行校验验证
      frame_count++;
      diag_3c.rtr = 0;
      diag_3c.byte(0) = product_Nad;
      diag_3c.byte(1) = 0x10;
      diag_3c.byte(2) = 0x0e;
      diag_3c.byte(3) = 0x31;
      diag_3c.byte(4) = 0x01;
      diag_3c.byte(5) = 0xff;
      diag_3c.byte(6) = 0x01;
      diag_3c.byte(7) = 0x00;
      output(diag_3c);
      diag_3c.rtr = 1;
      output(diag_3c);      
      break;
     case 207:
      frame_count++;
      diag_3c.rtr = 0;
      diag_3c.byte(0) = product_Nad;
      diag_3c.byte(1) = 0x21;
      diag_3c.byte(2) = 0x00;
      diag_3c.byte(3) = 0x48;
      diag_3c.byte(4) = 0x00;
      diag_3c.byte(5) = program_data_size[0];
      diag_3c.byte(6) = program_data_size[1];
      diag_3c.byte(7) = program_data_size[2];
      output(diag_3c);
      diag_3c.rtr = 1;
      output(diag_3c); 
      break;
     case 208:
      frame_count++;
      diag_3c.rtr = 0;
      diag_3c.byte(0) = product_Nad;
      diag_3c.byte(1) = 0x22;
      diag_3c.byte(2) = program_data_size[3];
      diag_3c.byte(3) = crc16_pro[0]; //校验和CRC16 MSB
      diag_3c.byte(4) = crc16_pro[1]; //校验和CRC16 LSB
      diag_3c.byte(5) = 0xff;
      diag_3c.byte(6) = 0xff;
      diag_3c.byte(7) = 0xff;
      output(diag_3c);
      diag_3c.rtr = 1;
      output(diag_3c); 
      break;
     case 209:
      frame_count=0;
      diag_3d.rtr = 1;
      output(diag_3d);      
      break;
     case 210:
      frame_count++;
      diag_3c.rtr = 0;
      diag_3c.byte(0) = product_Nad;
      diag_3c.byte(1) = 0x04;
      diag_3c.byte(2) = 0x31;
      diag_3c.byte(3) = 0x03; 
      diag_3c.byte(4) = 0xff; 
      diag_3c.byte(5) = 0x01;
      diag_3c.byte(6) = 0xff;
      diag_3c.byte(7) = 0xff;
      output(diag_3c);
      diag_3c.rtr = 1;
      output(diag_3c);       
      break;
    case 211:
      frame_count=0;
      diag_3d.rtr = 1;
      output(diag_3d); 
      break;
     case 212:
      frame_count++;
      diag_3c.rtr = 0;
      diag_3c.byte(0) = product_Nad;
      diag_3c.byte(1) = 0x02;
      diag_3c.byte(2) = 0x11;
      diag_3c.byte(3) = 0x01; 
      diag_3c.byte(4) = 0xff; 
      diag_3c.byte(5) = 0xff;
      diag_3c.byte(6) = 0xff;
      diag_3c.byte(7) = 0xff;
      output(diag_3c);
      diag_3c.rtr = 1;
      output(diag_3c);       
      break;
    case 213:
      frame_count=0;
      diag_3d.rtr = 1;
      output(diag_3d); 
      break;
  }
  setTimer(tmr1,15);
}

on sysvar User::step1_b1
{
  int var;
  var = sysGetVariableInt(sysvar::User::step1_b1);  
  if(var == 1)
  {
    frame_count = 1;
    linStopScheduler();
  }
}

on sysvar User::step1_b2
{
  int var;
  var = sysGetVariableInt(sysvar::User::step1_b2);  
  if(var == 1)
  {
    frame_count = 17;
  }
}


on sysvar User::enter_program
{
  int var;
  var = sysGetVariableInt(sysvar::User::enter_program);  
  if(var == 1)
  {
    frame_count = 101;
  }
}

//安全访问
on sysvar User::security_access
{
  int var;
  var = sysGetVariableInt(sysvar::User::security_access);  
  if(var == 1)
  {
    frame_count = 103;
  }
}
//发送密钥
on sysvar User::send_password
{
  int var;
  var = sysGetVariableInt(sysvar::User::send_password);  
  if(var == 1)
  {
    frame_count = 106;
  }
}

on sysvar User::write_version
{
  int var;
  var = sysGetVariableInt(sysvar::User::write_version);  
  if(var == 1)
  {
    frame_count = 107;
  }
}
//下载请求
on sysvar User::download_request
{
  int var;
  int size_y;
  var = sysGetVariableInt(sysvar::User::download_request);  
  if(var == 1)
  {
    //size_y = sysGetVariableInt(sysvar::User::hex_bin_size);
    //program_data_size[0] = (byte)(size_y >> 24);
    //program_data_size[1] = (byte)(size_y >> 16);
    //program_data_size[2] = (byte)(size_y >> 8);
    //program_data_size[3] = (byte)(size_y);
    frame_count = 90;
  }
}
//运行擦除flash例程
on sysvar User::erase_flash
{
  int var;
  var = sysGetVariableInt(sysvar::User::erase_flash);  
  if(var == 1)
  {
    frame_count = 111;
  }
}
//查看擦除结果
on sysvar User::erase_result
{
  int var;
  var = sysGetVariableInt(sysvar::User::erase_result);  
  if(var == 1)
  {
    frame_count = 115;
  }
}
//加载bin文件时候触发更新
on sysvar User::bin_file_name
{
  long pos;
  long t_pos;
  int var;
  int i;
  char file_pathname[1024];
  //sysvarString *file;
  //file = sysvar::User::bin_file_name;
  write("open file\r\n");
  
  //清空数据
  for(i=0;i<1024;i++) file_name[i]=0;
  for(i=0;i<1024;i++) file_path[i]=0;
  
  sysGetVariableString(sysvar::User::bin_file_name,file_pathname,elCount(file_pathname));
  str_replace(file_pathname,"\\","\\\\");
  pos = strstr(file_pathname,"\\\\");
  while(pos >= 0)
  {
    t_pos = pos;
    pos = strstr_off(file_pathname, t_pos+1, "\\\\");
  }  
  
  for(var = 0; var < t_pos; var++)
  {
    file_path[var] = file_pathname[var];
  }
    
  t_pos += 2;
  for(var = t_pos; var < strlen(file_pathname) ;var++)
  {
    file_name[var-t_pos] = file_pathname[var];
  }
}
//重新加载数据
on sysvar User::load_file
{
  int var;
  dword filehandle;
  var = sysGetVariableInt(sysvar::User::load_file);  
  if(var == 1)
  {
    write("path is %s",file_path);
    write("file is %s",file_name);
    setFilePath(file_path,0);
    filehandle = openFileRead(file_name,1);
    program_size = fileGetBinaryBlock(bin_buf,elcount(bin_buf),filehandle);
    write("program size is %d",program_size);
    sysSetVariableLongLong(sysvar::User::hex_bin_size,program_size);
    
    program_data_size[0] = (byte)(program_size >> 24);
    program_data_size[1] = (byte)(program_size >> 16);
    program_data_size[2] = (byte)(program_size >> 8);
    program_data_size[3] = (byte)(program_size);
  }
}
//传输数据
on sysvar User::send_bin
{
  int var;
  dword filehandle;
  int i,j;
  var = sysGetVariableInt(sysvar::User::send_bin);  
  if(var == 1)
  {
    block_count = program_size/64;
    write("%d\r\n",block_count);
    byte_tran_index = 0;
    frame_countinus_count = 0;
    block_tran_index = 0;
    block_data_index = 0;
    frame_count = 201; //刷新开始
  }
}
//退出下载
on sysvar User::quit_download
{
  int var;  
  var = sysGetVariableInt(sysvar::User::quit_download);
  if(var == 1)
  {
    frame_count = 204;
  }
}
//校验flash程序
on sysvar User::check_program
{
  int var;  
  long i;
  word crc_seed;
  byte cal_tmp;
  var = sysGetVariableInt(sysvar::User::check_program);
  if(var == 1)
  {
    crc_seed = 0xffff;
    for(i=0;i<program_size;i++)
    {
      cal_tmp=(crc_seed>>8)^bin_buf[i];
      crc_seed=(crc_seed<<8)^crctab[cal_tmp];
    }
    crc16_pro[0] = (byte)(crc_seed>>8);
    crc16_pro[1] = (byte)crc_seed;
    frame_count = 206;
  }
}
//获取校验结果
on sysvar User::check_refresh
{
  int var;  
  var = sysGetVariableInt(sysvar::User::check_refresh);
  if(var == 1)
  {
    frame_count = 210;
  }
}
//复位ecu
on sysvar User::reset_ecu
{
  int var;  
  var = sysGetVariableInt(sysvar::User::reset_ecu);
  if(var == 1)
  {
    frame_count = 212;
  }  
}
//
on linFrame 0x3D
{
  byte temp[32];
  switch(frame_count)
  {
    case 0:

    if(frame_count_0_last==353)
    {
      frame_count_0_last=0;
    software_assembly_part_no[8]=this.byte(2);
    software_assembly_part_no[9]=this.byte(3);
    software_assembly_part_no[10]=this.byte(4);
    software_assembly_part_no[11]=this.byte(5);
    software_assembly_part_no[12]=this.byte(6);
    sysSetVariableData(sysvar::ecuInfo::software_assembly_part_no,software_assembly_part_no,13);
      linStartScheduler();
    }
    break;

    case 5:
      bootloader_version[0]=this.byte(6);
      bootloader_version[1]=this.byte(7);
    break;
    case 6:
      bootloader_version[2] = this.byte(2);
      bootloader_version[3] = this.byte(3);
      bootloader_version[4] = this.byte(4);
      bootloader_version[5] = this.byte(5);
      bootloader_version[6] = this.byte(6);
      bootloader_version[7] = this.byte(7);
      sysSetVariableData(sysvar::ecuInfo::bootloader_version,bootloader_version,8);
    break;

    case 8:
      soft_version[0] = this.byte(6);
      soft_version[1] = this.byte(7);
      break;
    case 9:
      soft_version[2] = this.byte(2);
      soft_version[3] = this.byte(3);
      soft_version[4] = this.byte(4);
      soft_version[5] = this.byte(5);
      soft_version[6] = this.byte(6);
      soft_version[7] = this.byte(7);
     
      sysSetVariableData(sysvar::ecuInfo::software_version,soft_version,8);
      break;

    case 11:
    //读取VIN
    vehicle_VIN[0]=this.byte(7);
    break;
    case 12:
    //读取VIN
    vehicle_VIN[1]=this.byte(2);
    vehicle_VIN[2]=this.byte(3);
    vehicle_VIN[3]=this.byte(4);
    vehicle_VIN[4]=this.byte(5);
    vehicle_VIN[5]=this.byte(6);
    vehicle_VIN[6]=this.byte(7);
    break;
    case 13:
    //读取VIN
    vehicle_VIN[7]=this.byte(2);
    vehicle_VIN[8]=this.byte(3);
    vehicle_VIN[9]=this.byte(4);
    vehicle_VIN[10]=this.byte(5);
    vehicle_VIN[11]=this.byte(6);
    vehicle_VIN[12]=this.byte(7);
    break;
    case 14:
    //读取VIN
    vehicle_VIN[13]=this.byte(2);
    vehicle_VIN[14]=this.byte(3);
    vehicle_VIN[15]=this.byte(4);
    vehicle_VIN[16]=this.byte(5);
    sysSetVariableData(sysvar::ecuInfo::VIN,vehicle_VIN,17);
    break;

    case 16:
      hardware_version[0] = this.byte(6);
      hardware_version[1] = this.byte(7);
      break;
    case 17:
      frame_count_0_last=0;
      hardware_version[2] = this.byte(2);
      hardware_version[3] = this.byte(3);
      hardware_version[4] = this.byte(4);
     
      sysSetVariableData(sysvar::ecuInfo::hardware_version,hardware_version,8);
      break;

    case 312:
    //诊断模式
    diagnost_version[0]=this.byte(6);
    sysSetVariableData(sysvar::ecuInfo::diagnose_tast_mode,diagnost_version,1);
    break;

    case 314:
    //整车零部件号
    vehicle_part_no[0]=this.byte(6);
    vehicle_part_no[1]=this.byte(7);
    break;
    case 315:
    //整车零部件号
    vehicle_part_no[2]=this.byte(2);
    vehicle_part_no[3]=this.byte(3);
    vehicle_part_no[4]=this.byte(4);
    vehicle_part_no[5]=this.byte(5);
    vehicle_part_no[6]=this.byte(6);
    vehicle_part_no[7]=this.byte(7);
    break;
    case 317:
    //整车零部件号
    vehicle_part_no[8]=this.byte(2);
    vehicle_part_no[9]=this.byte(3);
    vehicle_part_no[10]=this.byte(4);
    vehicle_part_no[11]=this.byte(5);
    vehicle_part_no[12]=this.byte(6);
    sysSetVariableData(sysvar::ecuInfo::vehicle_part_no,vehicle_part_no,13);
    break;
      
    case 319:
    //应用软件版本号(固定版本）
    software_version_fixed[0]=this.byte(6);
    software_version_fixed[1]=this.byte(7);
    break;
    case 320:
    //应用软件版本号(固定版本）
    software_version_fixed[2] = this.byte(2);
    software_version_fixed[3] = this.byte(3);
    software_version_fixed[4] = this.byte(4);
    software_version_fixed[5] = this.byte(5);
    software_version_fixed[6] = this.byte(6);
    software_version_fixed[7] = this.byte(7);
    sysSetVariableData(sysvar::ecuInfo::software_version_fixed,software_version_fixed,8);
    break;

    case 322:
    //ECU标定软件号
    ecu_calibration_number[0]=this.byte(6);
    ecu_calibration_number[1]=this.byte(7);
    break;
    case 323:
    //ECU标定软件号
    ecu_calibration_number[2] = this.byte(2);
    ecu_calibration_number[3] = this.byte(3);
    ecu_calibration_number[4] = this.byte(4);
    ecu_calibration_number[5] = this.byte(5);
    ecu_calibration_number[6] = this.byte(6);
    ecu_calibration_number[7] = this.byte(7);
    sysSetVariableData(sysvar::ecuInfo::ECU_calibration_number,ecu_calibration_number,8);
    break;

    case 325:
    //系统供应商代码
    system_supplier_code[0]=this.byte(6);
    system_supplier_code[1]=this.byte(7);
    break;
    case 326:
    //系统供应商代码
    system_supplier_code[2] = this.byte(2);
    sysSetVariableData(sysvar::ecuInfo::system_supplier_code,system_supplier_code,3);
    break;

    case 328:
    //ECU生产日期
    ecu_production_date[0]=this.byte(6);
    ecu_production_date[1]=this.byte(7);
    break;
    case 329:
    //ECU生产日期
    ecu_production_date[2] = this.byte(2);
    ecu_production_date[3] = this.byte(3);
    sysSetVariableData(sysvar::ecuInfo::ECU_production_data,ecu_production_date,4);
    break;

    case 331:
    //控制器序列号
    ctrl_serial_number[0]=this.byte(7);
    break;
    case 332:
    //控制器序列号
    ctrl_serial_number[1] = this.byte(2);
    ctrl_serial_number[2] = this.byte(3);
    ctrl_serial_number[3] = this.byte(4);
    ctrl_serial_number[4] = this.byte(5);
    ctrl_serial_number[5] = this.byte(6);
    ctrl_serial_number[6] = this.byte(7);
    break;
    case 333:
    //控制器序列号
    ctrl_serial_number[7] = this.byte(2);
    ctrl_serial_number[8] = this.byte(3);
    ctrl_serial_number[9] = this.byte(4);
    ctrl_serial_number[10] = this.byte(5);
    ctrl_serial_number[11] = this.byte(6);
    ctrl_serial_number[12] = this.byte(7);
    break;
    case 334:
    //控制器序列号
    ctrl_serial_number[13] = this.byte(2);
    ctrl_serial_number[14] = this.byte(3);
    ctrl_serial_number[15] = this.byte(4);
    ctrl_serial_number[16] = this.byte(5);
    ctrl_serial_number[17] = this.byte(6);
    sysSetVariableData(sysvar::ecuInfo::ctrl_serial_number,ctrl_serial_number,18);
    break;

    case 336:
    //测试串口序列
    test_serial_no[0]=this.byte(6);
    test_serial_no[1]=this.byte(7);
    break;
    case 337:
    //测试串口序列
    test_serial_no[2]=this.byte(2);
    test_serial_no[3]=this.byte(3);
    test_serial_no[4]=this.byte(4);
    test_serial_no[5]=this.byte(5);
    test_serial_no[6]=this.byte(6);
    test_serial_no[7]=this.byte(7);
    break;
    case 338:
    //测试串口序列
    test_serial_no[8]=this.byte(2);
    test_serial_no[9]=this.byte(3);
    sysSetVariableData(sysvar::ecuInfo::test_serial_number,test_serial_no,10);
    break;

    case 340:
    //刷新日期
    update_date[0]=this.byte(6);
    update_date[1]=this.byte(7);
    break;
    case 341:
    //刷新日期
    update_date[2]=this.byte(2);
    update_date[3]=this.byte(3);
    sysSetVariableData(sysvar::ecuInfo::update_date,update_date,4);
    break;

    case 343:
    //ECU装配日期
    ecu_assembly_date[0]=this.byte(6);
    ecu_assembly_date[1]=this.byte(7);
    break;
    case 344:
    //ECU装配日期
    ecu_assembly_date[2]=this.byte(2);
    ecu_assembly_date[3]=this.byte(3);
    sysSetVariableData(sysvar::ecuInfo::ecu_assembly_date,ecu_assembly_date,4);
    break;

    case 346:
    //硬件版本
    hardware_version_no[0]=this.byte(6);
    hardware_version_no[1]=this.byte(7);
    break;
    case 347:
    //硬件版本
    hardware_version_no[2]=this.byte(2);
    hardware_version_no[3]=this.byte(3);
    hardware_version_no[4]=this.byte(4);
    sysSetVariableData(sysvar::ecuInfo::hardware_version_number,hardware_version_no,5);
    break;

    case 349:
    //软件总成
    software_assembly[0]=this.byte(6);
    software_assembly[1]=this.byte(7);
    break;
    case 350:
    //软件总成
    software_assembly[2]=this.byte(2);
    software_assembly[3]=this.byte(3);
    software_assembly[4]=this.byte(4);
    software_assembly[5]=this.byte(5);
    software_assembly[6]=this.byte(6);
    software_assembly[7]=this.byte(7);
    sysSetVariableData(sysvar::ecuInfo::software_assembly,software_assembly,8);
    break;

    case 352:
    //软件总成零件号
    software_assembly_part_no[0]=this.byte(6);
    software_assembly_part_no[1]=this.byte(7);
    break;
    case 353:
    //软件总成零件号
    software_assembly_part_no[2]=this.byte(2);
    software_assembly_part_no[3]=this.byte(3);
    software_assembly_part_no[4]=this.byte(4);
    software_assembly_part_no[5]=this.byte(5);
    software_assembly_part_no[6]=this.byte(6);
    software_assembly_part_no[7]=this.byte(7);
    break;
    case 354:
    //软件总成零件号

    break;


    case 23:
      if(this.byte(6) == 3)
      {
        frame_count = 21;//等待10次
      }
      if(this.byte(6) == 2) 
      {
        sysSetVariableInt(sysvar::User::safety_sta,1);
        //安全条件检查通过后，关闭DTC 关闭通信
        frame_count = 24;
      }
      if(this.byte(6) == 5) sysSetVariableInt(sysvar::User::safety_sta,0);
      break;
    case 105: //请求种子
      temp[0] = this.byte(4);
      temp[1] = this.byte(5);
      temp[2] = this.byte(6);
      temp[3] = this.byte(7);
      sysSetVariableData(sysvar::ecuInfo::security_seed,temp,4);
      break;
    case 203: //
      if(this.byte(2) == 0x76)
      {
        frame_count = 201;
      }
      break;
  }
}

