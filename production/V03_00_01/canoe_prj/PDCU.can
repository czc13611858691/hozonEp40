/*@!Encoding:936*/
includes
{
  
}

variables
{
  linFrame 0x3c diag_3c = {msgChannel = 1};
  msTimer delayTimer;
 byte gSeedArray[4];
    long APP_MASK = 0x460DB0A7;
}

on timer delayTimer
{
      diag_3c.rtr = 0;
      diag_3c.byte(0) = 1;
      diag_3c.byte(1) = 2;
      diag_3c.byte(2) = 0x10;
      diag_3c.byte(3) = 1;
      diag_3c.byte(4) = 255;
      diag_3c.byte(5) = 255;
      diag_3c.byte(6) = 255;
      diag_3c.byte(7) = 255;
      output(diag_3c);
      diag_3c.rtr = 1;
      output(diag_3c);
 setTimer(delayTimer,10); 

}

on start
{
  setTimer(delayTimer,10); 
}



long canculate_security_access_bcm(long seed, long APP_MASK)
{
long tmpseed = 0;
long key_1 = 0;
long seed_2 = 0;
  long key_2=0;
  long key=0;
  tmpseed = seed;
  key_1 = tmpseed ^ APP_MASK;
  seed_2 = tmpseed;
seed_2 = (seed_2 & 0x55555555) << 1 ^ (seed_2 & 0xAAAAAAAA) >> 1;
seed_2 = (seed_2 ^ 0x33333333) << 2 ^ (seed_2 ^ 0xCCCCCCCC) >> 2;
seed_2 = (seed_2 & 0x0F0F0F0F) << 4 ^ (seed_2 & 0xF0F0F0F0) >> 4;
seed_2 = (seed_2 ^ 0x00FF00FF) << 8 ^ (seed_2 ^ 0xFF00FF00) >> 8;
seed_2 = (seed_2 & 0x0000FFFF) << 16 ^ (seed_2 & 0xFFFF0000) >> 16;
key_2 = seed_2;
key = key_1 + key_2;
return key;
}
on diagResponse *
{
  byte data[4096];
  int64 seed;
  long size;
  diagResponse * resp; // declare response with no concrete interpretation
  size=this.GetPrimitiveSize(); // get length of response
  this.GetPrimitiveData(data, elcount(data)); // copy actual response from "on diagResponse *" into data array
  switch(data[0])
  {
    case 0x67: // UDS: SecurityAccess_Process positive Response
      if(data[1]==0x60) 
      {
        gSeedArray[0]=data[2];
        gSeedArray[1]=data[3];
        gSeedArray[2]=data[4];
        gSeedArray[3]=data[5];
      }
    case 0x50:// UDS: DiagnosticSessionControl_Process positive Response
    case 0x51: // UDS: EcuReset_Process positive Response
    case 0x7E: // UDS: TestPresent positive Response
    case 0x71: // UDS: Routine Control positive Response
    case 0x68: // UDS: CommunicationControl positive Response
    case 0x74: // UDS: RequestDownload positive Response
    case 0x76: // UDS: TransferData positive Response
    case 0x77: // UDS: RequestTransferExit positive Response
    case 0xC5: // UDS: ControlDTCSetting positive Response
      setTimer(delayTimer,10);
      break;
      
    case 0x7F:// UDS: Negative Response
      break;
    default:
      break;
  }
}